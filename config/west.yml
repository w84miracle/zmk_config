## config/west.yml
```yaml
manifest:
  remotes:
    - name: zmkfirmware
      url-base: https://github.com/zmkfirmware
    - name: krikun98
      url-base: https://github.com/krikun98
    - name: cdc-mkb
      url-base: https://github.com/cdc-mkb
    - name: w84miracle
      url-base: https://github.com/w84miracle
  projects:
    - name: zmk
      remote: w84miracle
      revision: mouse-pim447
      import: app/west.yml
  self:
    path: config
```
